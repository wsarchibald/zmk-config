## config/west.yml
```yaml
manifest:
  remotes:
    - name: zmkfirmware
      url-base: https://github.com/zmkfirmware
    - name: nick-conway
      url-base: https://github.com/nickconway/zmk-config.git
  projects:
    - name: zmk
      remote: nick-conway
      revision: esp32-s3-v3.5
      import: app/west.yml
  self:
    path: config
```
